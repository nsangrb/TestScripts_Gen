/*@!Encoding:1252*/
includes{
%INCLUDES%}

///@cond DoxyComp
variables{
%GLOBAL_VARS%//@cond DoxyComp
}
///@endcond

/*

************************************************************************************************************************************************
*INFORMATION
************************************************************************************************************************************************
@brief:			%TEST_DESCR%
------------------------------------------------------------------------------------------------------------------------------------------------
@SW release:    %RELEASE%
------------------------------------------------------------------------------------------------------------------------------------------------
@author:     	%AUTHOR%
@date:      	%DATE%
------------------------------------------------------------------------------------------------------------------------------------------------
@requirement(s):%REQUIREMENT%
------------------------------------------------------------------------------------------------------------------------------------------------
@test design:
%TEST_DESIGN%
------------------------------------------------------------------------------------------------------------------------------------------------
@comment:
%REGRESSION%
------------------------------------------------------------------------------------------------------------------------------------------------

*/

testcase %NAME%()
{
%INTERNAL_VARS%

	funcAgr_SetTestCase("%NAME%","%TEST_DESCR%");
	testReportFileName("%REPORT_PATH%");
%TEST_REGION%
}

